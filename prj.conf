## CMakeLists.txt
```
# SPDX-License-Identifier: Apache-2.0

cmake_minimum_required(VERSION 3.20.0)

find_package(Zephyr REQUIRED HINTS $ENV{ZEPHYR_BASE})
project(hello-printk)

target_sources(app PRIVATE src/main.c)
```

## prj.conf
```kconfig
CONFIG_USB_DEVICE_STACK=y
CONFIG_USB_CDC_ACM=y
CONFIG_CONSOLE=y
CONFIG_STDOUT_CONSOLE=y
CONFIG_PRINTK=y
CONFIG_SERIAL=y

# CONFIG_USB_UART_CONSOLE=y    # this config does *not* exist in zephyr 3.5
```

## usb.overlay
```dts
/ {
    chosen {
        zephyr,console = &cdc_acm_uart0;
    };
};

&usbd {
    cdc_acm_uart0: cdc_acm_uart0 {
        compatible = "zephyr,cdc-acm-uart";
    };
};
```

## src/main.c
```c
#include <zephyr/kernel.h>
#include <zephyr/sys/printk.h>
#include <zephyr/usb/usb_device.h>

int main(void)
{
    usb_enable(NULL);

    k_sleep(K_SECONDS(3));

    printk("Hello from printk over USB CDC!\n");

    return 0;
}
```
